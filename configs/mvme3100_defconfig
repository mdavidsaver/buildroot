## configs/mvme3100_defconfig
```kconfig
BR2_powerpc=y
BR2_powerpc_8540=y
BR2_POWERPC_SOFT_FLOAT=y
BR2_SVN="svn"
BR2_KERNEL_HEADERS_4_9=y
BR2_TOOLCHAIN_BUILDROOT_WCHAR=y
BR2_TOOLCHAIN_BUILDROOT_USE_SSP=y
BR2_BINUTILS_VERSION_2_28_X=y
BR2_GCC_VERSION_6_X=y
BR2_PACKAGE_HOST_GDB=y
BR2_ROOTFS_DEVICE_CREATION_DYNAMIC_MDEV=y
BR2_PACKAGE_BUSYBOX_SHOW_OTHERS=y
BR2_PACKAGE_I2C_TOOLS=y
BR2_PACKAGE_NANOCOM=y
BR2_PACKAGE_PCIUTILS=y
BR2_PACKAGE_RTC_TOOLS=y
BR2_PACKAGE_SETSERIAL=y
BR2_PACKAGE_CHRONY=y
BR2_PACKAGE_DHCPCD=y
BR2_PACKAGE_ETHTOOL=y
BR2_PACKAGE_IPUTILS=y
BR2_PACKAGE_MACCHANGER=y
BR2_PACKAGE_MII_DIAG=y
BR2_PACKAGE_PHYTOOL=y
BR2_PACKAGE_SOCAT=y
BR2_PACKAGE_TCPDUMP=y
BR2_PACKAGE_FILE=y
BR2_PACKAGE_NANO=y
BR2_TARGET_ROOTFS_CPIO=y
BR2_TARGET_ROOTFS_CPIO_BZIP2=y
# BR2_TARGET_ROOTFS_TAR is not set
```

## configs/zynqmp_zcu102_defconfig
```kconfig
BR2_aarch64=y
BR2_GLOBAL_PATCH_DIR="board/zynqmp/patches/"
BR2_PER_PACKAGE_DIRECTORIES=y
BR2_TOOLCHAIN_BUILDROOT_GLIBC=y
BR2_KERNEL_HEADERS_4_9=y
BR2_PACKAGE_GLIBC_UTILS=y
BR2_TOOLCHAIN_BUILDROOT_CXX=y
BR2_PACKAGE_HOST_GDB=y
BR2_PACKAGE_HOST_GDB_PYTHON3=y
BR2_TARGET_GENERIC_HOSTNAME="zcu102"
BR2_TARGET_GENERIC_ROOT_PASSWD="bpmlab"
BR2_TARGET_GENERIC_GETTY_PORT="ttyPS0"
BR2_TARGET_GENERIC_GETTY_BAUDRATE_115200=y
BR2_SYSTEM_DHCP="eth0"
BR2_LINUX_KERNEL=y
BR2_LINUX_KERNEL_CUSTOM_GIT=y
BR2_LINUX_KERNEL_CUSTOM_REPO_URL="http://github.com/Xilinx/linux-xlnx.git"
BR2_LINUX_KERNEL_CUSTOM_REPO_VERSION="xilinx-v2017.4"
BR2_LINUX_KERNEL_DEFCONFIG="xilinx_zynqmp"
BR2_LINUX_KERNEL_CONFIG_FRAGMENT_FILES="board/zynqmp/linux-dtsi.config"
BR2_LINUX_KERNEL_DTS_SUPPORT=y
BR2_LINUX_KERNEL_INTREE_DTS_NAME="xilinx/zynqmp-zcu102-rev1.0"
BR2_LINUX_KERNEL_DTB_OVERLAY_SUPPORT=y
BR2_PACKAGE_LINUX_TOOLS_GPIO=y
BR2_PACKAGE_LINUX_TOOLS_IIO=y
BR2_PACKAGE_STRACE=y
BR2_PACKAGE_LINUX_IIO_BPM=y
BR2_PACKAGE_NANOCOM=y
BR2_PACKAGE_PYTHON3=y
BR2_PACKAGE_PYTHON3_CURSES=y
BR2_PACKAGE_PYTHON3_READLINE=y
BR2_PACKAGE_PYTHON3_SSL=y
# BR2_PACKAGE_PYTHON3_UNICODEDATA is not set
BR2_PACKAGE_PYTHON3_ZLIB=y
BR2_PACKAGE_PYTHON_NUMPY=y
BR2_PACKAGE_LIBIIO=y
# BR2_PACKAGE_LIBIIO_NETWORK_BACKEND is not set
# BR2_PACKAGE_LIBIIO_USB_BACKEND is not set
# BR2_PACKAGE_LIBIIO_SERIAL_BACKEND is not set
BR2_PACKAGE_LIBIIO_TESTS=y
BR2_PACKAGE_LIBIIO_BINDINGS_PYTHON=y
BR2_PACKAGE_LIBEVENT=y
BR2_PACKAGE_SLANG=y
BR2_PACKAGE_DROPBEAR=y
BR2_PACKAGE_ETHTOOL=y
BR2_PACKAGE_SCREEN=y
BR2_PACKAGE_NANO=y
BR2_TARGET_ROOTFS_CPIO=y
BR2_TARGET_ROOTFS_CPIO_GZIP=y
BR2_TARGET_ROOTFS_CPIO_UIMAGE=y
# BR2_TARGET_ROOTFS_TAR is not set
BR2_PACKAGE_HOST_DOSFSTOOLS=y
BR2_PACKAGE_HOST_DTC=y
BR2_PACKAGE_HOST_E2FSPROGS=y
BR2_PACKAGE_HOST_GENIMAGE=y
BR2_PACKAGE_HOST_MTOOLS=y
```

## package/epics-base/Config.in
```kconfig
comment "EPICS Base needs MMU, uClibc or glibc, and toolchain w/ threads and C++"
	depends on BR2_TOOLCHAIN_USES_MUSL
	depends on !BR2_INSTALL_LIBSTDCPP
	depends on !BR2_TOOLCHAIN_HAS_THREADS
	depends on !BR2_USE_MMU

config BR2_PACKAGE_EPICS_BASE
	bool "EPICS Base"
	depends on !BR2_TOOLCHAIN_USES_MUSL
	depends on BR2_INSTALL_LIBSTDCPP
	depends on BR2_TOOLCHAIN_HAS_THREADS
	depends on BR2_USE_MMU # fork()
	select BR2_PACKAGE_READLINE
	help
	  Experimental Physics and Industrial Control Systems (EPICS)
	  core libraries and CLI utilities.

if BR2_PACKAGE_EPICS_BASE

config BR_EPICS_BASE_TARGET
	string "EPICS Target Arch"
	default "linux-aarch64" if BR2_aarch64
	default "linux-arm" if BR2_arm
	default "linux-microblaze" if BR2_microblazebe
	default "linux-ppc" if BR2_powerpc
	default "linux-ppc64" if BR2_powerpc64
	default "linux-x86" if BR2_i386
	default "linux-x86_64" if BR2_x86_64
	help
	  A name which selects target configuration files in the Base source tree.
	  
	  * linux-aarch64
	  * linux-arm
	  * linux-microblaze
	  * linux-ppc
	  * linux-ppc64
	  * linux-x86
	  * linux-x86_64
	  
	  See configure/os/CONFIG_SITE.Common.* for full list of valid names.

endif
```

## package/epics-iocstats/Config.in
```kconfig
if BR2_PACKAGE_EPICS_BASE

config BR2_PACKAGE_EPICS_IOCSTATS
	bool "IOC stats"
	depends on BR2_PACKAGE_EPICS_BASE

endif
```

## package/linux_iio_bpm/Config.in
```kconfig
config BR2_PACKAGE_LINUX_IIO_BPM
	bool "NSLS2 Kernel Modules"
	depends on BR2_LINUX_KERNEL
	help
	  Build/install kernel modules for UIO and IIO devices.

if BR2_PACKAGE_LINUX_IIO_BPM

config BR2_LINUX_IIO_BPM_REV
	string "NSLS2 Kernel Modules Git revision"
	default "0dca156d3dc48a7820bb0843a2d9a17fa6ce66e1"
	help
	  Revision in github repo.
	  https://github.com/mdavidsaver/linux_iio_bpm

endif
```

## package/procserv/Config.in
```kconfig
comment "procServ needs MMU, and toolchain w/ threads and C++"
	depends on !BR2_INSTALL_LIBSTDCPP
	depends on !BR2_TOOLCHAIN_HAS_THREADS
	depends on !BR2_USE_MMU

config BR2_PROCSERV
	bool "procServ"
	depends on BR2_INSTALL_LIBSTDCPP
	depends on BR2_TOOLCHAIN_HAS_THREADS
	depends on BR2_USE_MMU # fork()
	select BR2_PACKAGE_READLINE
	help
	  Wrapper to start arbitrary interactive commands in the background,
	  with (local) telnet or Unix domain socket access to stdin/stdout
```
